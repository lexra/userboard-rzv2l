## meta-userboard-rzv2l/conf/machine/rzv2l-dev.conf
```bitbake
#@TYPE: Machine
#@NAME: rzv2l-dev machine
#@DESCRIPTION: RZ/V2L DEV platform

SOC_FAMILY = "r9a07g054l"
require conf/machine/include/rzg2l-common.inc
require conf/machine/include/cip-core.inc

DEFAULTTUNE ?= "cortexa55"

TUNE_CONF ?= "conf/machine/include/tune-cortexa55.inc"
require ${TUNE_CONF}

PREFERRED_PROVIDER_virtual/kernel="linux-renesas"

UBOOT_CONFIG ??= "rzv2l-dev"
UBOOT_CONFIG[rzv2l-dev] = "rzv2l-dev_defconfig"

# flash writer
EXTRA_IMAGEDEPENDS += " flash-writer"
```
